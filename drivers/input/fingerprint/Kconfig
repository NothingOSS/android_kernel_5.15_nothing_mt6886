## drivers/input/fingerprint/Kconfig
```kconfig
config MTK_FINGERPRINT
	tristate "Mediatek Fingerprint" 
	default y
	help
	Fingerprint mtk driver enable/disable in the kernel. 
	Say Y here if you want to use mediatek fingerprint driver, 
	fingerprint driver will support fingerprint function in REE, 
	it supports Goodix's

config GOODIX_FINGERPRINT
	tristate "generic goodix fingerprint driver"
	default y
	help
	add support for goodix fingerprint driver.

source "drivers/input/fingerprint/goodix/Kconfig"
```

## drivers/input/fingerprint/goodix/Kconfig
```kconfig
config GOODIX_FINGERPRINT
	tristate "generic goodix fingerprint driver"
	default y
	help
	add support for goodix fingerprint driver.

config PRIZE_FP_USE_VFP
        bool "Fingerprint power vfp"
        default n
        help
        CHIPONE fingerprint CHIPONE's device.
```

## drivers/input/misc/aw_sar/Kconfig
```kconfig
#
# Mediatek AWINIC_SAR
#

config AWINIC_SAR
	tristate "Awinic AWINIC_SAR driver"
	depends on I2C
	help
	  Say Y here if you have Awinic AWINIC_SAR controller
	  chip in your system.
	  If unsure, say N.
	  To compile this driver as a module, choose M here: the
	  module will be called  AWINIC_SAR key.
```

## drivers/input/misc/goodix_gh621/Kconfig
```kconfig
config GH621X
	tristate "Goodix GH621X devices"
	depends on I2C
	help
	  Say Y here if you have a Goodix GH621X I2C devcies
	  controller.

          If unsure, say N.
```

## drivers/misc/board_id/Kconfig
```kconfig
config PRIZE_BOARD_ID
	tristate "prize board id config"
	help
	  Say Y here if you have a board id config and want to enable
	  support for the built-in board id.

	  If unsure, say N.
```

## drivers/misc/hardware_info/Kconfig
```kconfig
config PRIZE_HARDWARE_INFO
	tristate "hardware_info"
	default y
	help
	  hardware_info. If configures to be n, means devices doesn't support
	  hardwareinfo functionality.
```

## drivers/misc/mediatek/mminfra/Kconfig
```kconfig
# SPDX-License-Identifier: GPL-2.0

config MTK_MMINFRA
	tristate "MediaTek MMInfra driver"
	depends on ARCH_MEDIATEK || COMPILE_TEST
	help
	  This driver is for the Multimedia Infrastructure in MediaTek SoCs.
	  The MMINFRA driver mainly help control power, clock and security setting
	  for the bus of multimedia users, such as display, camera, mdp and video
	  codec. The MMINFRA driver also provide backup and restore function for
	  registers located in the same power domain.

config MTK_MMINFRA_DEBUG
	tristate "MediaTek MMInfra driver debug"
	depends on MTK_MMINFRA
	help
	  This extension enables debug features for MMINFRA driver. We only default
	  enable this in userdebug/eng load. With this extension enabled, you
	  can use adb command to dynamically do MMINFRA debug items. This extension
	  is by default disabled on user load for security concern.
```
