## drivers/misc/mediatek/pmic_tia/Kconfig
```kconfig
config MTK_PMIC_TIA
	tristate "MediaTek MTK_PMIC_TIA driver"
	help
	  Say y here to control pmic driver add pmic_tia node.
	  This config add pmic_tia node for wifi only project co-tms, wifi
	  only project will read GPS TSX DATA through pmic_tia node in
	  user layer.
```

## drivers/nothing_performance/Kconfig
```kconfig
config NOTHING_PERFORMANCE_FEATURE
	tristate "Enable nothing performance feature"
	default n
	help
	  Register vendor hook for nothing performance feature

config NOTHING_NAMED_THREAD_AFFINITY
	bool "Given target cpu affinity to threads with sepcific name"
	depends on NOTHING_PERFORMANCE_FEATURE
	help
	  With this feature, users can set CPU affinity for threads
	  based on a specific PID and thread name. The CPU affinity
	  will not be changed by the process itself.
```

## drivers/nothing_stability/Kconfig
```kconfig
config NOTHING_WRITRBACK_KMSG
	tristate "Nothing kernel writeback driver"
	default n
	help
		The driver logs power-on to system_stage kmsg log.
		So it doesn't log any customer info.
		When the device is stuck. It can help us debug.
		Check the /sys/devices/virtual/NT/NT_reserve_kernel_log/boot_stage_systemserver is exist.

config NOTHING_TASK_MEMINFO
	tristate "Nothing show all task memory info driver"
	default n
	help
		cat /proc/nt_meminfo/show_all_tasks will show all task meminfo

config NOTHING_DISK_USAGE
	tristate "Nothing show all file size module"
	default n
	help
		Detect malicious files and prevent them from encroaching on disk space

config NOTHING_TASK_INFO
	tristate "Nothing show all task info driver"
	default n
	help
		cat /proc/nt_taskinfo/show_all_tasks_id will show all task pid

config NOTHING_CHECK_PARTS
	tristate "Nothing check partitions status"
	default n
	help
		enable: echo fec_decode_rsb 1 > proc/nt_check_partitions/enable
		disable: echo fec_decode_rsb 0 > proc/nt_check_partitions/enable
		status: cat proc/nt_check_partitions/result
```
